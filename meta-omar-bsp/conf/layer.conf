## meta-omar-bsp/conf/machine/machine.conf
```bitbake
#@TYPE: Machine
#@NAME: RaspberryPi 3 Development Board
#@DESCRIPTION: Machine configuration for the RaspberryPi 3 in 64 bits mode

MACHINEOVERRIDES =. "raspberrypi3:"

require conf/machine/raspberrypi3-64.conf
require conf/machine/include/security_flags.inc
require conf/machine/include/no-gplv3.inc

SERIAL_CONSOLES ?= "115200;ttyS0"

# Disable machine recommends
MACHINE_ESSENTIAL_EXTRA_RRECOMMENDS = ""
MACHINE_EXTRA_RRECOMMENDS = ""

# Device Tree
RPI_KERNEL_DEVICETREE = " \
    bcm2710-rpi-3-b.dtb \
    bcm2710-rpi-3-b-plus.dtb\
"
RPI_KERNEL_DEVICETREE_OVERLAYS = "rpi-3-b-plus.dtbo"


# Bootloader
UBOOT_MACHINE = "rpi_arm64_config"
PREFERRED_PROVIDER_virtual/bootloader = "u-boot"
RPI_USE_U_BOOT = "1"

MACHINE_FEATURES = " \
    pci \
    apm \
    usbhost \
    keyboard \
    vfat \
    ext2 \
    screen \
    bluetooth \
    wifi \
    sdio \
    ${@bb.utils.contains('DISABLE_VC4GRAPHICS', '1', '', 'vc4graphics', d)} \
"
```

## meta-omar/wic/image.wks
```
part /boot --source bootimg-partition --ondisk mmcblk0 --fstype=vfat --label boot --active --align 4096 --size 100



part /rauc/rootfs.A --source rootfs --fstype=ext4 --label rootfsA --ondisk mmcblk0 --fixed-size 1024M

part /rauc/rootfs.B --source rootfs --fstype=ext4 --label rootfsB --ondisk mmcblk0 --fixed-size 1024M
```
